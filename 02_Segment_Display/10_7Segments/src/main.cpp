/*=======================================================*/
// 7Segments : 숫자 0~9 를 7세그먼트 한 자리에 표시한다
//
// 교재 3장 실습 3-3. 숫자마다 켜야 할 세그먼트를 바이트 하나에 적어 두고,
// 비트를 하나씩 꺼내 핀 8개로 내보낸다. 3.5절의 writeByte 와 같은 구조다.
//
// 표시기는 공통 애노드(common anode)다. 공통 단자가 5V 에 붙어 있으므로
// 세그먼트 핀을 LOW 로 내려야 그 세그먼트가 켜진다. 그래서 패턴의
// 0 이 "켠다", 1 이 "끈다"가 된다. 숫자 0 은 0b11000000 이다.
//   비트 0~6 = 세그먼트 a,b,c,d,e,f,g   비트 7 = 소수점(dp)
//
// 연결 (각 세그먼트에 저항 220옴)
//   세그먼트 a~g, dp : 0~7번 핀
//   공통 단자        : 5V
//   0·1번 핀까지 쓰므로 이 예제에서는 시리얼을 쓸 수 없다.
//
// 선행 학습 : 50_Bit_Mask      다음 단계 : 20_BCD_4511
/*=======================================================*/
#include <Arduino.h>

// 공통 애노드용 0~9 패턴. 비트가 0 인 세그먼트가 켜진다.
unsigned char SEG[10] = {0b11000000, 0b11111001,
                         0b10100100, 0b10110000,
                         0b10011001, 0b10010010,
                         0b10000010, 0b11111000,
                         0b10000000, 0b10010000};
unsigned char num = 0;

void setup()
{
  for (int i = 0; i < 8; i++) {
    pinMode(i, OUTPUT);       // 핀의 입출력 방향을 정한다
    digitalWrite(i, HIGH);    // HIGH = 꺼진 상태로 시작한다
  }
}

// ch 번째 숫자의 패턴을 비트 단위로 꺼내 0~7번 핀으로 내보낸다.
// SEG[ch] & (1<<i) 는 0 이 아니면 참이다. 값이 1 이 아니어도 된다(3.4절).
void dispSeg(unsigned char ch)
{
  for (int i = 0; i < 8; i++)
    digitalWrite(i, SEG[ch] & (1 << i));
}

void loop()
{
  dispSeg(num++);
  if (num > 9)
    num = 0;
  delay(500);
}
